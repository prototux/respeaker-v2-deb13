// SPDX-License-Identifier: (GPL-2.0+ OR MIT)
/*
 * DDR3 at 600 MHz (DDR3-1333 bin, the vendor kernel's "normal" rate).
 * Computed with Rockchip's DDR3 timing rules (vendor ddr_get_parameter()),
 * which reproduce the EVB values at 300 MHz:
 *   CL10 CWL7 tRCD=tRP=10, tRAS 37.5ns, tRC 53ns, tRRD 10ns, tWR 15ns (WR10),
 *   tRFC 350ns (safe up to 8Gb dies), tFAW 50ns.
 *   MR0 0xa60 (BL8 CL10 WR10), MR1 0x40 (40 ohm, RTT_NOM 120 ohm, DLL on),
 *   MR2 0x10 (CWL7). PHY ODT on (fixed in the driver), PHY DLL enabled.
 */
&dmc {
	rockchip,pctl-timing = <0x12c 0xc8 0x1f4 0x1e 0x8000004d 0x4 0xd2 0xa 0x5
		0x0 0xa 0x7 0x17 0x20 0xa 0x6 0x5
		0xa 0x5 0x200 0x5 0xf 0x40 0x0 0x1
		0x6 0x6 0x4 0xc 0x3c 0x100 0x0 0x5
		0x0 0x1248>;
	rockchip,phy-timing = <0xa60 0x40 0x10 0x0 0x0 0x4 0xa0>;
	rockchip,sdram-params = <0x186932d0 0x0 0x21 0x4f3 0x15
		0 600 3 0 120>;
};
