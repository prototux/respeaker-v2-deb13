// SPDX-License-Identifier: (GPL-2.0+ OR MIT)
/*
 * DDR3 at 786 MHz (the vendor kernel's maximum), EXPERIMENTAL. CL11 CWL8,
 * tRFC 300ns, MR0 0xc70 (CL11 WR12), MR2 0x18 (CWL8). The vendor wants
 * vdd_logic at 1.15 V here, which the PMIC may not provide at power-on.
 */
&dmc {
	rockchip,pctl-timing = <0x189 0xc8 0x1f4 0x27 0x8000004d 0x4 0xec 0xb 0x5
		0x0 0xb 0x8 0x1e 0x2a 0xb 0x8 0x6
		0xc 0x6 0x200 0x6 0x13 0x40 0x0 0x1
		0x8 0x8 0x5 0xc 0x4f 0x100 0x0 0x6
		0x0 0x17f2>;
	rockchip,phy-timing = <0xc70 0x40 0x18 0x0 0x0 0x4 0xb0>;
	rockchip,sdram-params = <0x1c695315 0x0 0x21 0x544 0x15
		0 786 3 0 120>;
};
