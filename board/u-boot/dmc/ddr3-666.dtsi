// SPDX-License-Identifier: (GPL-2.0+ OR MIT)
/*
 * DDR3 at 666 MHz, EXPERIMENTAL. CL10 CWL7, tRFC 350ns. Same controller
 * timings as the mainline RK3288 boards running DDR3 at 666 MHz. The vendor
 * wants vdd_logic at 1.15 V here, which the PMIC may not provide at power-on.
 */
&dmc {
	rockchip,pctl-timing = <0x14d 0xc8 0x1f4 0x21 0x8000004d 0x4 0xea 0xa 0x5
		0x0 0xa 0x7 0x19 0x24 0xa 0x7 0x5
		0xa 0x5 0x200 0x5 0x10 0x40 0x0 0x1
		0x7 0x7 0x4 0xc 0x43 0x100 0x0 0x5
		0x0 0x144a>;
	rockchip,phy-timing = <0xa60 0x40 0x10 0x0 0x0 0x4 0xa0>;
	rockchip,sdram-params = <0x186932d2 0x0 0x21 0x514 0x15
		0 666 3 0 120>;
};
